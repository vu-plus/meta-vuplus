## conf/machine/include/vuxxo.inc
```bitbake
# We know about rtc
MACHINE_FEATURES_BACKFILL_CONSIDERED = "rtc"

MACHINE_ESSENTIAL_EXTRA_RDEPENDS = " \
	vuplus-dvb-modules-${MACHINE} \
	${@bb.utils.contains("GST_VERSION", "1.0", "gstreamer1.0-libav", "gst-ffmpeg", d)} \
"

KERNEL_MODULE_AUTOLOAD += "xfs"

MACHINE_EXTRA_RRECOMMENDS = " \
	vuplus-shutdown \
	gst-plugin-dvbmediasink \
	ntfs-3g \
"

MACHINE_EXTRA_RDEPENDS += "\
	kernel-module-sr-mod \
	${@bb.utils.contains("MACHINE_FEATURES", "opera-browser", "enigma2-plugin-extensions-hbbtv", "", d)} \
"

EXTRA_IMAGEDEPENDS += "\
	vuplus-hbbtv-dumpait \
	vuplus-tuner-turbo \
"

TARGET_ARCH = "mipsel"
DEFAULTTUNE = "mips32el"

DVBMEDIASINK_CONFIG = "--with-wmv --with-pcm --with-eac3"

PREFERRED_VERSION_linux-${MACHINE} = "3.9.6"

PREFERRED_PROVIDER_virtual/kernel = "linux-${MACHINE}"

PREFERRED_PROVIDER_virtual/blindscan-dvbc = "vuplus-blindscan-utils-${MACHINE}"
PREFERRED_PROVIDER_virtual/blindscan-dvbs = "vuplus-blindscan-utils-${MACHINE}"

IMAGE_FSTYPES ?= "ubi"

UBI_VOLNAME = "rootfs"
MKUBIFS_ARGS = "-m 2048 -e 126976 -c 4096 -F"
UBINIZE_ARGS = "-m 2048 -p 128KiB"

IMAGEDIR ?= "${MACHINE}"
IMGDEPLOYDIR ?= "${DEPLOY_DIR_IMAGE}"
EXTRA_IMAGECMD_COMPAT = " --eraseblock=0x20000 -n -l "

IMAGE_CMD_ubi_prepend = " \
	rm -rf ${IMAGE_ROOTFS}/boot/*; \
	rm -rf ${IMAGE_ROOTFS}/tmp/*; \
"

IMAGE_CMD_ubi_append = " \
	mkdir -p ${IMGDEPLOYDIR}/vuplus/${UPDATE_DIR}; \
	cp -f ${IMGDEPLOYDIR}/${IMAGE_NAME}.rootfs.ubi ${IMGDEPLOYDIR}/vuplus/${UPDATE_DIR}/root_cfe_auto.jffs2; \
	gzip -f -9c ${DEPLOY_DIR_IMAGE}/vmlinux-${MACHINE}.bin > ${IMGDEPLOYDIR}/vuplus/${UPDATE_DIR}/kernel_cfe_auto.bin; \
	cd ${IMGDEPLOYDIR}; \
	zip ${DISTRO_NAME}-${DISTRO_VERSION}-${MACHINE}_usb.zip vuplus/${UPDATE_DIR}/*; \
	rm -rf vuplus; \
"

MACHINE_FEATURES += "alsa usbhost wlan kernelwifi externalwifi 3dtv switchoff osdposition hdmicec"

require conf/machine/include/tune-mips32.inc
```

## conf/machine/include/vuxxo2.inc
```bitbake
# We know about rtc
MACHINE_FEATURES_BACKFILL_CONSIDERED = "rtc"

MACHINE_ESSENTIAL_EXTRA_RDEPENDS = " \
	vuplus-dvb-modules-${MACHINE} \
	${@bb.utils.contains("GST_VERSION", "1.0", "gstreamer1.0-libav", "gst-ffmpeg", d)} \
"

KERNEL_MODULE_AUTOLOAD += "xfs"

MACHINE_EXTRA_RRECOMMENDS = " \
	vuplus-shutdown \
	gst-plugin-dvbmediasink \
	ntfs-3g \
"

MACHINE_EXTRA_RDEPENDS += "\
	kernel-module-sr-mod \
	${@bb.utils.contains("MACHINE_FEATURES", "opera-browser", "enigma2-plugin-extensions-hbbtv", "", d)} \
"

EXTRA_IMAGEDEPENDS += "\
	enigma2-plugin-systemplugins-firmwareupgrade \
	enigma2-plugin-systemplugins-remotecontrolcode \
	enigma2-plugin-extensions-addstreamurl \
	vuplus-hbbtv-dumpait \
	vuplus-tuner-turbo \
"

TARGET_ARCH = "mipsel"
DEFAULTTUNE = "mips32el"

DVBMEDIASINK_CONFIG = "--with-wmv --with-pcm --with-eac3"

PREFERRED_VERSION_linux-${MACHINE} = "3.13.5"

PREFERRED_PROVIDER_virtual/kernel = "linux-${MACHINE}"

PREFERRED_PROVIDER_virtual/blindscan-dvbc = "vuplus-blindscan-utils-${MACHINE}"
PREFERRED_PROVIDER_virtual/blindscan-dvbs = "vuplus-blindscan-utils-${MACHINE}"

PREFERRED_PROVIDER_virtual/egl = "libgles-${MACHINE}"
PREFERRED_PROVIDER_virtual/libgles2 = "libgles-${MACHINE}"

IMAGE_FSTYPES ?= "ubi"

UBI_VOLNAME = "rootfs"
MKUBIFS_ARGS = "-m 2048 -e 126976 -c ${MKFS_UBI_MAX_ERASE_BLK_COUNT}"
UBINIZE_ARGS = "-m 2048 -p 128KiB"

IMAGEDIR ?= "${MACHINE}"
IMGDEPLOYDIR ?= "${DEPLOY_DIR_IMAGE}"
EXTRA_IMAGECMD_COMPAT = " --eraseblock=0x20000 -n -l "

IMAGE_CMD_ubi_prepend = " \
	cp -f ${IMAGE_ROOTFS}/tmp/vmlinux.gz ${IMGDEPLOYDIR}/${IMAGE_NAME}.vmlinux.gz; \
	cp -f ${IMAGE_ROOTFS}/boot/initrd_cfe_auto.bin ${IMGDEPLOYDIR}/${IMAGE_NAME}.initrd_cfe_auto.bin; \
	rm -rf ${IMAGE_ROOTFS}/tmp/vmlinux.gz; \
	rm -rf ${IMAGE_ROOTFS}/boot/initrd_cfe_auto.bin; \
"

IMAGE_CMD_ubi_append = " \
	mkdir -p ${IMGDEPLOYDIR}/vuplus/${UPDATE_DIR}; \
	cp -f ${IMGDEPLOYDIR}/${IMAGE_NAME}.rootfs.ubi ${IMGDEPLOYDIR}/vuplus/${UPDATE_DIR}/root_cfe_auto.bin; \
	cp -f ${IMGDEPLOYDIR}/${IMAGE_NAME}.vmlinux.gz ${IMGDEPLOYDIR}/vuplus/${UPDATE_DIR}/kernel_cfe_auto.bin; \
	cp -f ${IMGDEPLOYDIR}/${IMAGE_NAME}.initrd_cfe_auto.bin ${IMGDEPLOYDIR}/vuplus/${UPDATE_DIR}/initrd_cfe_auto.bin; \
	touch ${IMGDEPLOYDIR}/vuplus/${UPDATE_DIR}/${FORCE_REBOOT_OPTION}.update; \
	cd ${IMGDEPLOYDIR}; \
	zip ${DISTRO_NAME}-${DISTRO_VERSION}-${MACHINE}_usb.zip vuplus/${UPDATE_DIR}/*; \
	rm -rf vuplus; \
"

MACHINE_FEATURES += "alsa usbhost wlan kernelwifi extrakernelwifi 3dtv switchoff osdposition hdmicec fan"

require conf/machine/include/tune-mips32.inc

HOSTTOOLS += "sshpass"
```

## conf/machine/include/vuxxo4k.inc
```bitbake
# We know about rtc
MACHINE_FEATURES_BACKFILL_CONSIDERED = "rtc"

MACHINE_ESSENTIAL_EXTRA_RDEPENDS = " \
	${@base_contains("MACHINE_FEATURES", "dvbproxy", "vuplus-dvb-proxy-${MACHINE} libgles-${MACHINE} vuplus-platform-util-${MACHINE}", "vuplus-dvb-modules-${MACHINE}", d)} \
	${@base_contains("GST_VERSION", "1.0", "gstreamer1.0-libav", "gst-ffmpeg", d)} \
"

KERNEL_MODULE_AUTOLOAD += "xfs"

MACHINE_EXTRA_RRECOMMENDS = " \
	vuplus-shutdown \
	gst-plugin-dvbmediasink \
	ntfs-3g \
"

EXTRA_IMAGEDEPENDS += "\
	enigma2-plugin-systemplugins-remotecontrolcode \
	enigma2-plugin-extensions-addstreamurl \
	vuplus-tuner-turbo \
	${@base_contains("MACHINE_FEATURES", "bluetooth", "enigma2-plugin-systemplugins-bluetoothsetup", "", d)} \
	${@base_contains("MACHINE_FEATURES", "bcmwifi", "vuplus-wifi-util-${MACHINE}", "", d)} \
"

TARGET_ARCH = "arm"
DEFAULTTUNE = "armv7ahf-neon"

DVBMEDIASINK_CONFIG = "--with-wmv --with-pcm --with-eac3 --with-h265"

PREFERRED_VERSION_linux-${MACHINE} = "3.14.28"

PREFERRED_PROVIDER_virtual/kernel = "linux-${MACHINE}"

PREFERRED_PROVIDER_virtual/blindscan-dvbc = "vuplus-blindscan-utils-${MACHINE}"
PREFERRED_PROVIDER_virtual/blindscan-dvbs = "vuplus-blindscan-utils-${MACHINE}"

IMAGE_FSTYPES ?= "tar.bz2"

IMAGEDIR ?= "${MACHINE}"
IMGDEPLOYDIR ?= "${DEPLOY_DIR_IMAGE}"

IMAGE_CMD_tar_prepend = " \
        mkdir -p ${IMGDEPLOYDIR}/vuplus/${UPDATE_DIR}; \
        cp -f ${IMAGE_ROOTFS}/tmp/zImage ${IMGDEPLOYDIR}/vuplus/${UPDATE_DIR}/kernel_auto.bin; \
        cp -f ${IMAGE_ROOTFS}/boot/initrd_auto.bin ${IMGDEPLOYDIR}/vuplus/${UPDATE_DIR}/initrd_auto.bin; \
	touch ${IMGDEPLOYDIR}/vuplus/${UPDATE_DIR}/${FORCE_REBOOT_OPTION}.update; \
        rm -rf ${IMAGE_ROOTFS}/tmp/zImage; \
        rm -rf ${IMAGE_ROOTFS}/boot/initrd_auto.bin; \
        cd ${IMAGE_ROOTFS}; \
        tar -cvf ${IMGDEPLOYDIR}/rootfs.tar -C ${IMAGE_ROOTFS} .; \
        mv -f ${IMGDEPLOYDIR}/rootfs.tar ${IMGDEPLOYDIR}/vuplus/${UPDATE_DIR}/rootfs.tar; \
        bzip2 ${IMGDEPLOYDIR}/vuplus/${UPDATE_DIR}/rootfs.tar; \
        cd ${IMGDEPLOYDIR}; \
        zip ${IMAGE_NAME}_usb.zip vuplus/${UPDATE_DIR}/*; \
        rm -rf vuplus; \
"

MACHINE_FEATURES += "alsa usbhost wlan kernelwifi extrakernelwifi 3dtv switchoff osdposition hdmicec"

require conf/machine/include/arm/arch-armv7a.inc
```

## conf/machine/vuduo.conf
```bitbake
#@TYPE: Machine
#@NAME: Vu+ Duo
#@DESCRIPTION: Machine configuration for the Vu+ Duo

UPDATE_DIR = "duo"

MTD_KERNEL = "mtd1"

require conf/machine/include/vuxxo.inc

MACHINE_FEATURES += "textlcd opera-browser"

CHIPSET = "bcm7335"

MACHINE_KERNEL_PR = "r5"
```

## conf/machine/vuduo2.conf
```bitbake
#@TYPE: Machine
#@NAME: Vu+ Duo2
#@DESCRIPTION: Machine configuration for the Vu+ Duo2

UPDATE_DIR = "duo2"

MTD_KERNEL = "mtd2"

require conf/machine/include/vuxxo2.inc

IMAGE_INSTALL_append += "\
	vuplus-initrd-${MACHINE} \
	enigma2-plugin-extensions-lcd4linux \
	vuplus-coldboot \
"

EXTRA_IMAGEDEPENDS += "\
	enigma2-plugin-systemplugins-manualfancontrol \
"

MACHINE_FEATURES += "dvb-c blindscan-dvbc blindscan-dvbs hbbtv wol ctrlrc transcoding streamproxy opera-browser"

CHIPSET = "bcm7424"

MKFS_UBI_MAX_ERASE_BLK_COUNT = "8192"
FORCE_REBOOT_OPTION = "reboot"

MACHINE_KERNEL_PR = "r1"
```

## conf/machine/vuduo4k.conf
```bitbake
#@TYPE: Machine
#@NAME: Vu+ Duo4k
#@DESCRIPTION: Machine configuration for the Vu+ Duo4k

UPDATE_DIR = "duo4k"

MTD_KERNEL = "mmcblk0p6"

require conf/machine/include/vuxxo4k.inc

DVBMEDIASINK_CONFIG += " --with-vb9"

IMAGE_INSTALL_append += "\
	vuplus-initrd-${MACHINE} \
	enigma2-plugin-systemplugins-bluetoothsetup \
	vuplus-bluetooth-util-${MACHINE} \
	vuplus-wifi-util-${MACHINE} \
	"

PREFERRED_VERSION_mmc-utils = "0.2"
PREFERRED_VERSION_linux-${MACHINE} = "4.1.45"

MACHINE_FEATURES += "dvb-c blindscan-dvbc blindscan-dvbs webkithbbtv ctrlrc colorlcd transcoding streamproxy dvbproxy mmc bluetooth bcmwifi kodi chromiumos hdmi-in-helper"

CHIPSET = "bcm7278"

FORCE_REBOOT_OPTION = "reboot"

MACHINE_KERNEL_PR = "r0"

IMAGE_FSTYPES =+ "ext4"
```

## conf/machine/vuduo4kse.conf
```bitbake
#@TYPE: Machine
#@NAME: Vu+ Duo4k
#@DESCRIPTION: Machine configuration for the Vu+ Duo4kSE

UPDATE_DIR = "duo4kse"

MTD_KERNEL = "mmcblk0p6"

require conf/machine/include/vuxxo4k.inc

DVBMEDIASINK_CONFIG += " --with-vb9"

IMAGE_INSTALL_append += "\
	vuplus-initrd-${MACHINE} \
	enigma2-plugin-systemplugins-bluetoothsetup \
	vuplus-bluetooth-util-${MACHINE} \
	vuplus-wifi-util-${MACHINE} \
	"

PREFERRED_VERSION_linux-${MACHINE} = "4.1.45"

MACHINE_FEATURES += "dvb-c blindscan-dvbc blindscan-dvbs webkithbbtv ctrlrc colorlcd transcoding streamproxy dvbproxy mmc bluetooth bcmwifi chromiumos hdmi-in-helper"

CHIPSET = "bcm7444"

FORCE_REBOOT_OPTION = "reboot"

MACHINE_KERNEL_PR = "r0"

IMAGE_FSTYPES =+ "ext4"
```

## conf/machine/vusolo.conf
```bitbake
#@TYPE: Machine
#@NAME: Vu+ Solo
#@DESCRIPTION: Machine configuration for the Vu+ Solo

UPDATE_DIR = "solo"

MTD_KERNEL = "mtd1"

require conf/machine/include/vuxxo.inc

CHIPSET = "bcm7325"

MACHINE_KERNEL_PR = "r5"
```

## conf/machine/vusolo2.conf
```bitbake
#@TYPE: Machine
#@NAME: Vu+ Solo2
#@DESCRIPTION: Machine configuration for the Vu+ Solo2

UPDATE_DIR = "solo2"

MTD_KERNEL = "mtd2"

require conf/machine/include/vuxxo2.inc

IMAGE_INSTALL_append += "vuplus-initrd-${MACHINE}"

EXTRA_IMAGEDEPENDS += " \
	enigma2-plugin-systemplugins-manualfancontrol \
"

MACHINE_FEATURES += "textlcd hbbtv transcoding streamproxy blindscan-dvbs ctrlrc opera-browser"

CHIPSET = "bcm7356"

MKFS_UBI_MAX_ERASE_BLK_COUNT = "4096"
FORCE_REBOOT_OPTION = "reboot"

MACHINE_KERNEL_PR = "r2"
```

## conf/machine/vusolo4k.conf
```bitbake
#@TYPE: Machine
#@NAME: Vu+ Solo4k
#@DESCRIPTION: Machine configuration for the Vu+ Solo4k

UPDATE_DIR = "solo4k"

MTD_KERNEL = "mmcblk0p1"

require conf/machine/include/vuxxo4k.inc

IMAGE_INSTALL_append += "\
	vuplus-initrd-${MACHINE} \
	enigma2-plugin-systemplugins-bluetoothsetup \
	vuplus-bluetooth-util-${MACHINE} \
	"

EXTRA_IMAGEDEPENDS += "\
	enigma2-plugin-extensions-webkithbbtv \
"

MACHINE_FEATURES += "dvb-c blindscan-dvbc blindscan-dvbs hbbtv ctrlrc colorlcd transcoding streamproxy dvbproxy mmc bluetooth kodi"

CHIPSET = "bcm7376"

FORCE_REBOOT_OPTION = "reboot"

MACHINE_KERNEL_PR = "r1"

IMAGE_FSTYPES =+ "ext4"
```

## conf/machine/vusolose.conf
```bitbake
#@TYPE: Machine
#@NAME: Vu+ SoloSE
#@DESCRIPTION: Machine configuration for the Vu+ SoloSe

UPDATE_DIR = "solose"

require conf/machine/include/vuxxo2.inc

IMAGE_INSTALL_append += "\
	vuplus-initrd-${MACHINE} \
	"

MACHINE_FEATURES += "dvb-c blindscan-dvbc blindscan-dvbs hbbtv ctrlrc vupluszap transcoding"

CHIPSET = "bcm7241"

MKFS_UBI_MAX_ERASE_BLK_COUNT = "4096"
FORCE_REBOOT_OPTION = "force"

MACHINE_KERNEL_PR = "r1"
```

## conf/machine/vuultimo.conf
```bitbake
#@TYPE: Machine
#@NAME: Vu+ Ultimo
#@DESCRIPTION: Machine configuration for the Vu+ Ultimo

UPDATE_DIR = "ultimo"

MTD_KERNEL = "mtd1"

require conf/machine/include/vuxxo.inc

EXTRA_IMAGEDEPENDS += "\
	enigma2-plugin-systemplugins-manualfancontrol \
	enigma2-plugin-systemplugins-firmwareupgrade \
	enigma2-plugin-systemplugins-remotecontrolcode \
	enigma2-plugin-systemplugins-ledbrightnesssetup \
	"

MACHINE_FEATURES += "dvb-c blindscan-dvbc blindscan-dvbs ctrlrc opera-browser"

CHIPSET = "bcm7413"

MACHINE_KERNEL_PR = "r5"
```

## conf/machine/vuultimo4k.conf
```bitbake
#@TYPE: Machine
#@NAME: Vu+ Ultimo4k
#@DESCRIPTION: Machine configuration for the Vu+ Ultimo4k

UPDATE_DIR = "ultimo4k"

require conf/machine/include/vuxxo4k.inc

DVBMEDIASINK_CONFIG += " --with-vb9"

IMAGE_INSTALL_append += "\
	vuplus-initrd-${MACHINE} \
	enigma2-plugin-systemplugins-bluetoothsetup \
	vuplus-bluetooth-util-${MACHINE} \
	vuplus-wifi-util-${MACHINE} \
	"

MACHINE_FEATURES += "dvb-c blindscan-dvbc blindscan-dvbs webkithbbtv ctrlrc colorlcd transcoding streamproxy dvbproxy mmc bluetooth bcmwifi kodi chromiumos hdmi-in-helper colorlcd800 HDMI-IN-FHD"

CHIPSET = "bcm7444"

FORCE_REBOOT_OPTION = "reboot"

MACHINE_KERNEL_PR = "r1"

IMAGE_FSTYPES =+ "ext4"

MTD_ROOTFS = "mmcblk0p4"

SOC_FAMILY = "bcm7444"
```

## conf/machine/vuuno4k.conf
```bitbake
#@TYPE: Machine
#@NAME: Vu+ Uno4k
#@DESCRIPTION: Machine configuration for the Vu+ Uno4k

UPDATE_DIR = "uno4k"

MTD_KERNEL = "mmcblk0p1"

require conf/machine/include/vuxxo4k.inc

DVBMEDIASINK_CONFIG += " --with-vb9"

IMAGE_INSTALL_append += "\
	vuplus-initrd-${MACHINE} \
	enigma2-plugin-systemplugins-bluetoothsetup \
	vuplus-bluetooth-util-${MACHINE} \
	"

MACHINE_FEATURES += "dvb-c blindscan-dvbc webkithbbtv ctrlrc transcoding streamproxy dvbproxy mmc bluetooth kodi chromiumos"

CHIPSET = "bcm7252S"

FORCE_REBOOT_OPTION = "force"

MACHINE_KERNEL_PR = "r1"

IMAGE_FSTYPES =+ "ext4"
```

## conf/machine/vuuno4kse.conf
```bitbake
#@TYPE: Machine
#@NAME: Vu+ Uno4kSE
#@DESCRIPTION: Machine configuration for the Vu+ Uno4kSE

UPDATE_DIR = "uno4kse"

MTD_KERNEL = "mmcblk0p1"

require conf/machine/include/vuxxo4k.inc

DVBMEDIASINK_CONFIG += " --with-vb9"

IMAGE_INSTALL_append += "\
	vuplus-initrd-${MACHINE} \
	enigma2-plugin-systemplugins-bluetoothsetup \
	vuplus-bluetooth-util-${MACHINE} \
"

EXTRA_IMAGEDEPENDS += "\
	enigma2-plugin-extensions-webkithbbtv \
"

MACHINE_FEATURES += "dvb-c blindscan-dvbc hbbtv ctrlrc colorlcd transcoding streamproxy dvbproxy mmc bluetooth kodi"

CHIPSET = "bcm7252S"

FORCE_REBOOT_OPTION = "reboot"

MACHINE_KERNEL_PR = "r0"

IMAGE_FSTYPES =+ "ext4"

PREFERRED_VERSION_linux-${MACHINE} = "4.1.20"
```

## conf/machine/vuzero.conf
```bitbake
#@TYPE: Machine
#@NAME: Vu+ Zero
#@DESCRIPTION: Machine configuration for the Vu+ Zero

UPDATE_DIR = "zero"

require conf/machine/include/vuxxo2.inc

IMAGE_INSTALL_append += "\
	vuplus-initrd-${MACHINE} \
	"

MACHINE_FEATURES += "hbbtv ctrlrc vupluszap"

CHIPSET = "bcm7362"

MKFS_UBI_MAX_ERASE_BLK_COUNT = "4096"
FORCE_REBOOT_OPTION = "force"

MACHINE_KERNEL_PR = "r1"
```

## conf/machine/vuzero4k.conf
```bitbake
#@TYPE: Machine
#@NAME: Vu+ Zero4K
#@DESCRIPTION: Machine configuration for the Vu+ Zero4K

UPDATE_DIR = "zero4k"

MTD_KERNEL = "mmcblk0p4"

require conf/machine/include/vuxxo4k.inc

DVBMEDIASINK_CONFIG += " --with-vb9"

IMAGE_INSTALL_append += "\
	vuplus-initrd-${MACHINE} \
	enigma2-plugin-systemplugins-bluetoothsetup \
	vuplus-bluetooth-util-${MACHINE} \
	"

EXTRA_IMAGEDEPENDS += " \
	enigma2-plugin-extensions-webkithbbtv \
"

MACHINE_FEATURES += "dvb-c blindscan-dvbc blindscan-dvbs hbbtv ctrlrc dvbproxy mmc bluetooth kodi"

CHIPSET = "bcm72604"

FORCE_REBOOT_OPTION = "force"

MACHINE_KERNEL_PR = "r0"

IMAGE_FSTYPES =+ "ext4"

PREFERRED_VERSION_linux-${MACHINE} = "4.1.20"
```
